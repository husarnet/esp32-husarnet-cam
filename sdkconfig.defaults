## sdkconfig.defaults
```kconfig
CONFIG_IDF_TARGET="esp32"

CONFIG_AUTOSTART_ARDUINO=y
CONFIG_FREERTOS_HZ=1000
# CONFIG_WS2812_LED_ENABLE is not set
CONFIG_MBEDTLS_PSK_MODES=y
CONFIG_MBEDTLS_KEY_EXCHANGE_PSK=y

CONFIG_LWIP_HOOK_IP6_ROUTE_DEFAULT=y
CONFIG_EXAMPLE_CONNECT_IPV6=n
CONFIG_ESP_TASK_WDT_TIMEOUT_S=10

CONFIG_ESP32_SPIRAM_SUPPORT=y
CONFIG_PARTITION_TABLE_CUSTOM=y
CONFIG_ESPTOOLPY_FLASHSIZE_4MB=y
```
